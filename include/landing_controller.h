#pragma once

#include <stdint.h>

// =============================================================================
// LandingController
// -----------------------------------------------------------------------------
// ToF-driven auto-landing. Takes the current ToF altitude (mm) and produces a
// throttle command (0..100%) that descends the airframe at a controlled sink
// rate, transitions to a slow final-meter approach, then cuts throttle on
// touchdown.
//
// State machine:
//   IDLE        — controller is disengaged
//   DESCEND     — above kSlowApproachMm; sink rate held at kCruiseSinkMs
//   APPROACH    — between kTouchdownMm and kSlowApproachMm; sink rate held at
//                 kSlowSinkMs
//   TOUCHDOWN   — at/below kTouchdownMm AND vertical velocity < kStableVzMs
//                 for kTouchdownHoldMs → motors cut
//   COMPLETE    — landing complete; caller should disarm
//
// PID closes on the desired sink rate (m/s), not on altitude directly. The
// outer setpoint is generated by the state machine. Output is throttle bias
// around hover (the caller adds hoverThrottlePct to get the absolute command).
// =============================================================================

class LandingController {
 public:
  enum class State : uint8_t {
    IDLE      = 0,
    DESCEND   = 1,
    APPROACH  = 2,
    TOUCHDOWN = 3,
    COMPLETE  = 4,
  };

  struct Config {
    float kP = 18.0f;                  // throttle %/m/s sink-rate error
    float kI = 4.0f;
    float kD = 0.0f;
    float maxIntegPct = 25.0f;
    float maxThrottlePct = 80.0f;      // cap so we never spike thrust during landing
    float hoverThrottlePct = 50.0f;    // base throttle when sink rate = 0
    float cruiseSinkMs = 0.7f;         // m/s descent above slow-approach
    float slowSinkMs = 0.25f;          // m/s descent in final meter
    uint16_t slowApproachMm = 1000;    // height (mm) at which we slow down
    uint16_t touchdownMm = 80;         // height (mm) below which we consider landed
    float stableVzMs = 0.1f;           // |Vz| below this with touchdownMm reached = landed
    uint32_t touchdownHoldMs = 600;    // continuous time below touchdownMm before motors cut
  };

  struct Output {
    float throttlePct = 0.0f;          // absolute commanded throttle (caller writes to motors)
    float targetSinkRateMs = 0.0f;
    State state = State::IDLE;
    bool requestDisarm = false;
  };

  void configure(const Config& cfg) { cfg_ = cfg; }

  void begin() {
    state_ = State::DESCEND;
    integPct_ = 0.0f;
    lastErr_ = 0.0f;
    haveLast_ = false;
    touchdownStartMs_ = 0;
  }

  void cancel() {
    state_ = State::IDLE;
    integPct_ = 0.0f;
  }

  // altitudeMm: current ToF altitude (mm). vzMs: current vertical velocity
  // (m/s, positive = up). dtSeconds: PID period. nowMs: caller's millis().
  Output update(uint16_t altitudeMm, float vzMs, float dtSeconds, uint32_t nowMs) {
    Output out;
    out.state = state_;
    if (state_ == State::IDLE || state_ == State::COMPLETE) {
      return out;
    }
    if (dtSeconds <= 0.0f) dtSeconds = 0.002f;

    // ---- State transitions ----
    if (state_ == State::DESCEND && altitudeMm <= cfg_.slowApproachMm) {
      state_ = State::APPROACH;
    }
    if ((state_ == State::DESCEND || state_ == State::APPROACH) &&
        altitudeMm <= cfg_.touchdownMm) {
      state_ = State::TOUCHDOWN;
      touchdownStartMs_ = nowMs;
    }

    // ---- Touchdown hold-and-disarm ----
    if (state_ == State::TOUCHDOWN) {
      // Allow a small re-bound (rising back above touchdown) without losing
      // the timer — bench experiments showed ToF noise of ~30 mm near ground.
      const bool stillNearGround = altitudeMm < (cfg_.touchdownMm + 50U);
      const bool stableVelocity = (vzMs > -cfg_.stableVzMs && vzMs < cfg_.stableVzMs);
      if (!(stillNearGround && stableVelocity)) {
        // Conditions broke before hold elapsed; restart timer if still in range
        if (stillNearGround) {
          touchdownStartMs_ = nowMs;
        } else {
          // Bounce — go back to APPROACH to recapture
          state_ = State::APPROACH;
        }
      } else if ((nowMs - touchdownStartMs_) >= cfg_.touchdownHoldMs) {
        state_ = State::COMPLETE;
        out.state = state_;
        out.requestDisarm = true;
        out.throttlePct = 0.0f;
        return out;
      }
    }

    // ---- Sink-rate setpoint ----
    float targetVz = -cfg_.cruiseSinkMs;
    if (state_ == State::APPROACH) targetVz = -cfg_.slowSinkMs;
    if (state_ == State::TOUCHDOWN) targetVz = -cfg_.slowSinkMs * 0.5f;
    out.targetSinkRateMs = targetVz;

    // ---- PID on sink-rate error (positive error = we're descending too slow) ----
    const float err = targetVz - vzMs;  // negative if going too fast down
    integPct_ = clampf(integPct_ + err * dtSeconds, -cfg_.maxIntegPct, cfg_.maxIntegPct);
    const float d = haveLast_ ? (err - lastErr_) / dtSeconds : 0.0f;
    const float pidOut = cfg_.kP * err + cfg_.kI * integPct_ + cfg_.kD * d;
    lastErr_ = err;
    haveLast_ = true;

    // Output = hover throttle + PID correction, clamped
    out.throttlePct = clampf(cfg_.hoverThrottlePct + pidOut, 0.0f, cfg_.maxThrottlePct);
    out.state = state_;
    return out;
  }

  void setGains(float p, float i, float d) {
    cfg_.kP = p; cfg_.kI = i; cfg_.kD = d;
  }

  State state() const { return state_; }
  bool active() const { return state_ != State::IDLE && state_ != State::COMPLETE; }
  const Config& config() const { return cfg_; }

 private:
  static float clampf(float v, float lo, float hi) {
    if (v < lo) return lo;
    if (v > hi) return hi;
    return v;
  }

  Config cfg_;
  State state_ = State::IDLE;
  float integPct_ = 0.0f;
  float lastErr_ = 0.0f;
  bool haveLast_ = false;
  uint32_t touchdownStartMs_ = 0;
};
